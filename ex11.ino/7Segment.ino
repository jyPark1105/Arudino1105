/* 뭘 코딩할건지
스위치 + 7-segment를 구현할 것
배열을 통해서
byte numbers라는 배열을 선언하는데 세로줄: 16줄, 가로칸 8칸 / a ~ dp -> 2 ~ 9번 pin 연결
*/
int Pin = 2; // a부터 1씩 증가하여 a~dp까지 2~9번 핀의 값 출력
int Num = 0; // 세로 인덱스
int i;       // 가로 인덱스
byte Numbers[16][8] = { // 10 8 굳이 안써도 됨. 어차피 변수값 넣을 것임
{1,1,1,1,1,1,0,0}, // 0
{0,1,1,0,0,0,0,0}, // 1
{1,1,0,1,1,0,1,0}, // 2
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{1,1,0,0,1,1,1,0}  // F , 16진수 값을 7-segment에 표현하기 위해 byte 설정함
};

void setup {
    for(i = 0; i < 8; i++)
    {
      pinMode(Pin + i, OUTPUT); // 2~9까지 출력상태로 설정(0 or 1 value)
    }
    digitalWrite(9, HIGH); // dp부분 켜놓고 시작(소수점)
}


// 루프문에서 pin들을 켜는 작업을 해야함.
void loop {
    for(i = 0; i < 8; i++)
    {
      digitalWrite(Pin + i, Numbers[num][i]);
    }
    Num++;
    if(Num > 15)   // 세로줄이 9번째 이후는 없으니까 다시 초기화 시켜줌
    {
      Num = 0;
    } delay(1000); // 1초 지연
}
